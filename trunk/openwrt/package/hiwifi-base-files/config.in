## trunk/openwrt/package/hiwifi-base-files/config.in
```kconfig
config HIWIFI_FIRMWARE_VERSION
        depends on PACKAGE_hiwifi-base-files
        string
		default "HiWiFi"
        prompt "Firmware Name"
        help
          Firmware name.
```
